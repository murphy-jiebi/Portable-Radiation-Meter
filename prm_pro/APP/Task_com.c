#include "Task_com.h"
#include "string.h"
#include "bsp_uart.h"
#include "user.h"

uint8_t dtSendCnt = 0;
uint8_t dtRecCnt = 0;

uint8_t Detector_group[10][8] = {

	{0x07, 0x31, 0x30, 0x52, 0x44, 0x46, 0x45, 0x03},
	{0x07, 0x30, 0x31, 0x52, 0x44, 0x46, 0x45, 0x03},
	{0x07, 0x30, 0x32, 0x52, 0x44, 0x46, 0x46, 0x03},
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	{0x07, 0x30, 0x39, 0x52, 0x44, 0x30, 0x36, 0x03},
//{0x87, 0x30, 0x35, 0xD2, 0x44, 0x30, 0xB2, 0x03},
	//{0x07,0x31,0x31,0x52,0x44,0x46,0x46,0x03},
	//{0x07,0x31,0x32,0x52,0x44,0x30,0x30,0x03},
	//{0x07,0x31,0x33,0x52,0x44,0x30,0x31,0x03},
	//{0x07,0x31,0x34,0x52,0x44,0x30,0x32,0x03},
	//{0x07,0x31,0x35,0x52,0x44,0x30,0x33,0x03},
	//{0x07,0x31,0x36,0x52,0x44,0x30,0x34,0x03},
	//{0x07,0x31,0x37,0x52,0x44,0x30,0x35,0x03},
	//{0x07,0x31,0x38,0x52,0x44,0x30,0x36,0x03},
	//{0x07,0x31,0x39,0x52,0x44,0x30,0x37,0x03},
//{0x87, 0x30, 0x35, 0xD2, 0x44, 0x30, 0xB2, 0x03},
};



void DetectoCom(uint8_t tick)
{
	uint16 i, m;
	int state;
	float f_value;
	uint8_t ReceBuf[200];
	float nbr;
	float calibFactor = 1.0f;
	static uint8 s_ucIndex = 0x00; /* 探测器编�? */
	static uint8_t getIndex = 0;
	//	static uint8_t AlarmOutPut = DETECTOR_FAULT;  /* 总状�? */
	

	if (g_tUart3.ucRxFrame != 0x00)
	{
		for (m = 0; m < g_tUart3.usRxCount; m++)
		{
			ReceBuf[m] = g_tUart3.pRxBuf[m] & 0x7F;
		}
		if (memcmp(ReceBuf, Detector_group[s_ucIndex], 5) == 0x00)
		{
			// if (detectorType == DETECTOR_2)
			// {
			// 	sscanf((char *)(ReceBuf + 3), "RD %f %d %f", &f_value, &state, &nbr);
			// }
			// else
			// {
			// 	sscanf((char *)(ReceBuf + 3), "RD %f  ", &f_value);
			// }
//			Detector[i].Value = f_value * calibFactor; /* 校准系数 */
			sscanf((char *)(ReceBuf + 3), "RD %f  ", &f_value);
			extDtDoserate = f_value;
			dtRecCnt++;
			getIndex = 1;
		}

		g_tUart3.usRxCount = 0;
		g_tUart3.ucRxFrame = 0x00;
	}

	if (!tick)
	{
		return;
	}
	if(!getIndex)
	{
		s_ucIndex++;
		if (s_ucIndex >= 10)
		{
			s_ucIndex = 0;
		}
	}
	
	uart_send_buf(&g_tUart3, Detector_group[s_ucIndex], 8);
	dtSendCnt++;
}

uint16_t DebugReplyFramePacket(uint8_t *buf, uint8_t cmd)
{
	uint16_t i = 0;
	

}

void DebugDataParse(uint8_t *buf, uint16_t len)
{
	uint16_t i = 0;
	uint8_t sendBuf[64];
	uint16_t sendLen = 0;

	uart_send_buf(&g_tUart0, sendBuf, sendLen);
}


void Task_com(uint8_t tick)
{
	DetectoCom(tick);

//	if (g_tUart3.ucRxFrame != 0x00)
//	{
//		memset(g_tUart3.pRxBuf, 0x00, g_tUart3.usRxCount);
//		g_tUart3.usRxCount = 0;
//		g_tUart2.ucRxFrame = 0x00;
//		
//	}

	if (g_tUart0.ucRxFrame != 0x00)
	{
		DebugDataParse(g_tUart0.pRxBuf, g_tUart0.usRxCount);
		g_tUart0.usRxCount = 0;
		g_tUart0.ucRxFrame = 0x00;
	}
}


